## config/boards/shields/lily58_handwired/Kconfig.defconfig
```kconfig
if SHIELD_LILY58_HANDWIRED_LEFT

config ZMK_KEYBOARD_NAME
    default "Lily58"

config ZMK_SPLIT_ROLE_CENTRAL
    default y

endif


if SHIELD_LILY58_HANDWIRED_RIGHT

config ZMK_KEYBOARD_NAME
    default "Lily58"

endif
```

## config/boards/shields/lily58_handwired/Kconfig.shield
```kconfig
config SHIELD_LILY58_HANDWIRED_LEFT
    def_bool $(shields_list_contains,lily58_handwired_left)

config SHIELD_LILY58_HANDWIRED_RIGHT
    def_bool $(shields_list_contains,lily58_handwired_right)
```
